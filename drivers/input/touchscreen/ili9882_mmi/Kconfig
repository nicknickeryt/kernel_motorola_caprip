## drivers/input/touchscreen/ili9882_mmi/Kconfig
```kconfig
#
# Ilitek_9882 Touchscreen driver configuration
#

config TOUCHSCREEN_ILITEK_CHIPSET
	tristate "Moto Ilitek_9882 Touchscreen"
	default n
	help
	  Say Y here if you have a Moto Novatek NT36xxx no flash touchscreen connected
	  to your system by SPI bus.

	  If unsure, say N.

config INPUT_ILI_0FLASH_MMI_ENABLE_DOUBLE_TAP
	bool "Moto Ilitek_9882 Doubel Tap"
	depends on TOUCHSCREEN_ILITEK_CHIPSET
	default n
	help
	  Say Y here if you want to have Double tap support on Moto Novatek NT36xxx.

	  If unsure, say N.

config CONFIG_INPUT_ILI_PANEL_NOTIFICATIONS
	bool "Moto Ilitek_9882 Panel Notification"
	depends on TOUCHSCREEN_ILITEK_CHIPSET
	default n
	help
	  Say Y here if you want to have panel notification support on Moto Novatek NT36xxx.

	  If unsure, say N.

config CONFIG_ILITEK_RESUME_BY_DDI
        bool "Moto Ilitek_9882 Resume by Display Driver Integration"
        depends on TOUCHSCREEN_ILITEK_CHIPSET
        default n
        help
          Say Y here if you want to have panel notification support on Moto Novatek NT36xxx.

          If unsure, say N.

config CONFIG_ILITEK_FW_PANEL
        bool "Moto Ilitek_9882 Firmware Panel"
        depends on TOUCHSCREEN_ILITEK_CHIPSET
        default n
        help
          Say Y here if you want to have panel notification support on Moto Novatek NT36xxx.

          If unsure, say N.

# Need add firmware path? Add here.

config CONFIG_ILITEK_ESD
        bool "Moto Ilitek_9882 Electrostatic Discharge"
        depends on TOUCHSCREEN_ILITEK_CHIPSET
        default n
        help
          Say Y here if you want to have panel notification support on Moto Novatek NT36xxx.

          If unsure, say N.

config CONFIG_ILITEK_GESTURE
        bool "Moto Ilitek_9882 Gesture"
        depends on TOUCHSCREEN_ILITEK_CHIPSET
        default n
        help
          Say Y here if you want to have panel notification support on Moto Novatek NT36xxx.

          If unsure, say N.

config CONFIG_ILITEK_PANEL_GESTURE
        bool "Moto Ilitek_9882 Panel Gesture"
        depends on TOUCHSCREEN_ILITEK_CHIPSET
        default n
        help
          Say Y here if you want to have panel notification support on Moto Novatek NT36xxx.

          If unsure, say N.
```
